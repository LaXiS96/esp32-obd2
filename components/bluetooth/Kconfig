## components/bluetooth/Kconfig
```kconfig
menu "Bluetooth"

    config BT_QUEUES_LEN
        int "Bluetooth message queue size"
        default 8

    config BT_TX_TASK_PRIO
        int "Bluetooth TX task priority"
        default 1

endmenu
```

## components/can/Kconfig
```kconfig
menu "CAN bus"

    config CAN_TX_GPIO_NUM
        int "CAN TX GPIO number"
        default 21

    config CAN_RX_GPIO_NUM
        int "CAN RX GPIO number"
        default 22

    config CAN_RX_TASK_PRIO
        int "CAN RX task priority"
        default 1

endmenu
```

## components/slcan/Kconfig
```kconfig
menu "SLCAN"

    config SLCAN_SERIAL_RX_TASK_PRIO
        int "SLCAN serial RX task priority"
        default 1

    config SLCAN_CAN_RX_TASK_PRIO
        int "SLCAN CAN RX task priority"
        default 1

endmenu
```

## main/Kconfig
```kconfig
menu "Application configuration"

    config APP_BT_QUEUES_LEN
        int "Bluetooth message queue size"
        default 8

    config APP_BT_TX_TASK_PRIO
        int "Bluetooth TX task priority"
        default 1

    config APP_CAN_TX_GPIO_NUM
        int "CAN TX GPIO number"
        default 21

    config APP_CAN_RX_GPIO_NUM
        int "CAN RX GPIO number"
        default 22

    config APP_CAN_RX_TASK_PRIO
        int "CAN RX task priority"
        default 1

    config APP_SLCAN_SERIAL_RX_TASK_PRIO
        int "SLCAN serial RX task priority"
        default 1

    config APP_SLCAN_CAN_RX_TASK_PRIO
        int "SLCAN CAN RX task priority"
        default 1

endmenu
```

## sdkconfig.defaults
```kconfig
# 4MB flash
CONFIG_ESPTOOLPY_FLASHSIZE_4MB=y

# 240MHz CPU frequency
CONFIG_ESP_DEFAULT_CPU_FREQ_MHZ_240=y

# Bluetooth
CONFIG_BT_ENABLED=y
CONFIG_BTDM_CTRL_MODE_BR_EDR_ONLY=y
CONFIG_BT_BLE_ENABLED=n
CONFIG_BT_CLASSIC_ENABLED=y
CONFIG_BT_SPP_ENABLED=y
CONFIG_BT_SSP_ENABLED=n
```
